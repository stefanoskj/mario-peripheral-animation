&spi0 {
    nice_view_spi: /* label */ ;
    cs-gpios = <&gpio0 14 GPIO_ACTIVE_HIGH>;
};

&nice_view_spi {
    status = "okay";
    nice_view: ls0xx@0 {
        compatible = "sharp,ls0xx";
        spi-max-frequency = <1000000>;
        reg = <0>;
        width = <160>;
        height = <68>;
    };
};

&nice_view_spi {
    zephyr,display = &nice_view;
};/* 3️⃣ Tell Zephyr which node is the display (used by ZMK) */
&nice_view_spi {
    zephyr,display = &nice_view;
};
